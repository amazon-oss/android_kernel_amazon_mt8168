## drivers/staging/amazon/Kconfig
```kconfig
menu "Amazon"

config AMAZON
	bool "Amazon Drivers"
	default N
	---help---
	  Enable support for various drivers needed on the Amazon Fire OS platform

if AMAZON

config INPUT_AMZN_KEYCOMBO
	tristate "Amazon key combo"
	depends on INPUT
	select INPUT_KEYCOMBO
	help
	  Say Y here if you want to panic kernel / power off when some keys are pressed;

	  To compile this driver as a module, choose M here: the
	  module will be called amzn_keycombo.

config USER_BUILD
	bool "USER_BUILD"
	default n
	help
	  Indicate if user build

endif # if AMAZON

source "drivers/staging/amazon/dspframework/Kconfig"

endmenu
```

## drivers/staging/amzn/Kconfig
```kconfig
menu "Amzn"

config AMZN
	bool "Amazon Common Drivers"
	default N
	---help---
	  Enable support for various drivers needed on the Amazon Fire OS platform

if AMZN

config AMZN_SIGN_OF_LIFE
	bool "Amazon Sign of Life"
	help
	enable the life cycle metrics to log device boot and shutdown information

config AMZN_SIGN_OF_LIFE_RTC
        bool "Amazon Sign of Life platform implementation"
        help
        enable the life cycle metrics to log device boot and shutdown information on specific Platform

config AMZN_POWEROFF_LOG
	bool "Long press key power off log"
	default N
	help
	enable Long press key power off log

config AMZN_INPUT_KEYCOMBO
	tristate "Amazon key combo"
	depends on INPUT
	select INPUT_KEYCOMBO
	help
	  Say Y here if you want to panic kernel / power off when some keys are pressed;

	  To compile this driver as a module, choose M here: the
	  module will be called amzn_keycombo.

config AMZN_IDME
	bool "IDME support"
	depends on PROC_FS
	help
	  Select Y here to enable IDME support to read the data
	  via userspace (i.e. /proc/idme/* entries)

source "drivers/staging/amzn/dspframework/Kconfig"

endif # if AMZN

endmenu
```
